/*
 * CAUTION: This file is automatically generated by Xilinx.
 * Version: XSCT 2023.2
 * Today is: Sat Jan  6 13:00:35 2024
 */


/dts-v1/;
#include "zynq-7000.dtsi"
#include "pl.dtsi"
#include "pcw.dtsi"
/ {
	chosen {
		bootargs = "earlycon";
		stdout-path = "serial0:115200n8";
	};
	aliases {
		serial0 = &uart1;
	};
	memory@0 {
		device_type = "memory";
		reg = <0x0 0x10000000>;
	};
};
